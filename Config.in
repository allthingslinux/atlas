## Config.in
```kconfig
source "$BR2_EXTERNAL_KEYCHAIN_PATH/package/sunxi-tools-f1c100s/Config.in.host"
source "$BR2_EXTERNAL_KEYCHAIN_PATH/package/sunxi-tools-f1c100s/Config.in"
source "$BR2_EXTERNAL_KEYCHAIN_PATH/package/2048/Config.in"
source "$BR2_EXTERNAL_KEYCHAIN_PATH/package/robotfindskitten/Config.in"

source "$BR2_EXTERNAL_KEYCHAIN_PATH/package/librecode/Config.in"
```

## board/keychain/v1/uboot_defconfig
```kconfig
CONFIG_ARM=y
CONFIG_ARCH_SUNXI=y
CONFIG_DEFAULT_DEVICE_TREE="suniv-f1c100s-keychain"
# CONFIG_OF_UPSTREAM is not set
CONFIG_SPL=y
CONFIG_MACH_SUNIV=y
CONFIG_DRAM_CLK=132
CONFIG_DRAM_ZQ=0
# CONFIG_VIDEO_SUNXI is not set
CONFIG_SPL_SPI_SUNXI=y

# SPI NOR flash support (required for SPI flash boot)
CONFIG_SF_DEFAULT_BUS=0
CONFIG_SF_DEFAULT_CS=0
CONFIG_SF_DEFAULT_MODE=0
CONFIG_SF_DEFAULT_SPEED=24000000
CONFIG_SPI_FLASH=y
CONFIG_DM_SPI_FLASH=y
CONFIG_SPI_FLASH_WINBOND=y
CONFIG_SPI_FLASH_XTX=y
CONFIG_SPI_FLASH_MTD=y
CONFIG_CMD_SF=y

# MTD and UBI/UBIFS support (required for UBI partitions)
CONFIG_MTD=y
CONFIG_DM_MTD=y
CONFIG_MTD_SPI_NOR=y
CONFIG_MTD_PARTITIONS=y
CONFIG_MTD_DEVICE=y
CONFIG_CMD_MTDPARTS=y
CONFIG_CMD_UBI=y
CONFIG_CMD_UBIFS=y
CONFIG_MTD_UBI=y
CONFIG_UBIFS_FS=y
CONFIG_MTD_UBI_FASTMAP=y
CONFIG_MTD_UBI_BEB_LIMIT=20
CONFIG_MTD_UBI_WL_THRESHOLD=4096

# Environment in SPI flash (stores U-Boot env variables)
CONFIG_ENV_IS_IN_SPI_FLASH=y
CONFIG_ENV_SPI_BUS=0
CONFIG_ENV_SPI_CS=0
CONFIG_ENV_SPI_MAX_HZ=50000000
CONFIG_ENV_SPI_MODE=0
CONFIG_ENV_SIZE=0x2000
CONFIG_ENV_OFFSET=0x80000

# MTD partition table definition (updated for raw partitions)
CONFIG_MTDIDS_DEFAULT="nor0=spi0.0"
CONFIG_MTDPARTS_DEFAULT="mtdparts=spi0.0:1M(uboot),4M(kernel),64k(dtb),-(rootfs)"

# Custom boot command for SPI flash raw partitions (overrides distro_bootcmd)
CONFIG_USE_BOOTCOMMAND=y
CONFIG_BOOTCOMMAND="sf probe 0:0 50000000; mtdparts default; echo Loading kernel from 0x100000...; sf read 0x80800000 0x100000 0x400000; echo Loading dtb from 0x500000...; sf read 0x80700000 0x500000 0x10000; echo Kernel loaded, checking header...; md.b 0x80800000 0x40; echo DTB loaded, checking header...; md.b 0x80700000 0x40; echo Setting bootargs...; setenv bootargs 'console=ttyS0,115200 earlyprintk debug loglevel=8 root=/dev/mtdblock3 ro rootfstype=squashfs'; echo Booting with verbose output...; bootz 0x80800000 - 0x80700000"

CONFIG_SPI=y
CONFIG_DM_SPI=y
CONFIG_CONS_INDEX=1
CONFIG_BAUDRATE=115200

# Immediate boot - no delay in development
CONFIG_BOOTDELAY=0
CONFIG_BOOT_DELAY=0
```

## configs/keychain_defconfig
```kconfig
BR2_arm=y
BR2_arm926t=y
BR2_ARCH="arm"
BR2_GCC_TARGET_ARCH="armv5tej"
BR2_GCC_TARGET_CPU="arm926ej-s"
BR2_GCC_TARGET_ABI="aapcs-linux"
BR2_GCC_TARGET_FLOAT_ABI="softfp"
BR2_GCC_TARGET_MODE="arm"
BR2_TOOLCHAIN_BUILDROOT_CXX=y
BR2_SVN="svn"
BR2_CCACHE=y
BR2_PACKAGE_HOST_GENIMAGE=y
BR2_SHARED_STATIC_LIBS=y
BR2_GLOBAL_PATCH_DIR="$(BR2_EXTERNAL_KEYCHAIN_PATH)/patches"
BR2_TARGET_GENERIC_HOSTNAME="keychain"
BR2_TARGET_GENERIC_ISSUE="Welcome to ATLAS!"
BR2_TARGET_GENERIC_GETTY_PORT="/dev/ttyS0"
BR2_TARGET_GENERIC_GETTY_BAUDRATE_115200=y
# BR2_TARGET_GENERIC_REMOUNT_ROOTFS_RW is not set
BR2_ROOTFS_OVERLAY="$(BR2_EXTERNAL_KEYCHAIN_PATH)/board/keychain/v1/rootfs_overlay"
BR2_ROOTFS_POST_BUILD_SCRIPT="$(BR2_EXTERNAL_KEYCHAIN_PATH)/board/keychain/v1/post-build.sh"
BR2_ROOTFS_POST_IMAGE_SCRIPT="$(BR2_EXTERNAL_KEYCHAIN_PATH)/board/keychain/v1/custom-genimage.sh"
BR2_ROOTFS_POST_IMAGE_SCRIPT_ARGS="-c $(BR2_EXTERNAL_KEYCHAIN_PATH)/board/keychain/v1/genimage.cfg"
BR2_LINUX_KERNEL=y
BR2_LINUX_KERNEL_USE_CUSTOM_CONFIG=y
BR2_LINUX_KERNEL_CUSTOM_CONFIG_FILE="$(BR2_EXTERNAL_KEYCHAIN_PATH)/board/keychain/v1/linux_defconfig"
BR2_LINUX_KERNEL_DTS_SUPPORT=y
BR2_LINUX_KERNEL_CUSTOM_DTS_DIR="$(BR2_EXTERNAL_KEYCHAIN_PATH)/board/keychain/v1/dts/"
BR2_PACKAGE_DHRYSTONE=y
BR2_PACKAGE_STRESS=y
BR2_PACKAGE_MTD=y
# BR2_PACKAGE_MTD_FLASHCP is not set
# BR2_PACKAGE_MTD_FLASH_ERASE is not set
# BR2_PACKAGE_MTD_FLASH_LOCK is not set
# BR2_PACKAGE_MTD_FLASH_UNLOCK is not set
# BR2_PACKAGE_MTD_MTD_DEBUG is not set
# BR2_PACKAGE_MTD_NANDDUMP is not set
# BR2_PACKAGE_MTD_NANDTEST is not set
# BR2_PACKAGE_MTD_NANDWRITE is not set
BR2_PACKAGE_MICROPYTHON=y
BR2_PACKAGE_MICROPYTHON_LIB=y
BR2_PACKAGE_LIBTIRPC=y
# BR2_PACKAGE_IFUPDOWN_SCRIPTS is not set
BR2_TARGET_ROOTFS_SQUASHFS=y
BR2_TARGET_ROOTFS_SQUASHFS4_XZ=y
BR2_TARGET_UBOOT=y
BR2_TARGET_UBOOT_USE_CUSTOM_CONFIG=y
BR2_TARGET_UBOOT_CUSTOM_CONFIG_FILE="$(BR2_EXTERNAL_KEYCHAIN_PATH)/board/keychain/v1/uboot_defconfig"
BR2_TARGET_UBOOT_NEEDS_DTC=y
BR2_TARGET_UBOOT_NEEDS_PYLIBFDT=y
# BR2_TARGET_UBOOT_FORMAT_BIN is not set
BR2_TARGET_UBOOT_FORMAT_CUSTOM=y
BR2_TARGET_UBOOT_FORMAT_CUSTOM_NAME="u-boot-sunxi-with-spl.bin"
BR2_TARGET_UBOOT_CUSTOM_DTS_PATH="$(BR2_EXTERNAL_KEYCHAIN_PATH)/board/keychain/v1/dts/allwinner/suniv-f1c100s-keychain.dts"
BR2_PACKAGE_HOST_MKPASSWD=y
BR2_PACKAGE_HOST_MTD=y
BR2_PACKAGE_2048=y
BR2_PACKAGE_ROBOTFINDSKITTEN=y
BR2_PACKAGE_SUNXI_TOOLS_F1C100S=y
BR2_PACKAGE_HOST_SUNXI_TOOLS_F1C100S=y
BR2_PACKAGE_SUNXI_TOOLS_F1C100S_FEL=y
BR2_PACKAGE_HOST_SUNXI_TOOLS_F1C100S_FEL=y
```

## package/sunxi-tools-f1c100s/Config.in.host
```kconfig
config BR2_PACKAGE_HOST_SUNXI_TOOLS_F1C100S
	bool "host sunxi-tools for F1C100s"
	help
	  Tools for Allwinner A10 (aka sun4i) and A13 (aka sun5i)
	  based devices. This includes fex2bin which can be used to
	  compile .fex board definition files to the binary script.bin
	  format required by the linux-sunxi kernel. These tools are
	  specific for linux-sunxi kernel and do not apply to the
	  mainline Linux kernel version.

	  http://linux-sunxi.org/Sunxi-tools

if BR2_PACKAGE_HOST_SUNXI_TOOLS_F1C100S

config BR2_PACKAGE_HOST_SUNXI_TOOLS_F1C100S_FEL
	bool "host sunxi-fel"
	depends on BR2_TOOLCHAIN_HAS_THREADS # libusb
	select BR2_PACKAGE_HOST_LIBUSB
	select BR2_PACKAGE_HOST_ZLIB
	help
	  Enable sunxi-fel for the host. This tool is used to communicate
	  with the device in FEL mode, allowing to write images to flash.

comment "host sunxi-fel needs a toolchain w/ threads"
	depends on !BR2_TOOLCHAIN_HAS_THREADS

endif
```
